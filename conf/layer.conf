## conf/layer.conf
```bitbake
#
# Copyright (C) 2020 Wind River Systems, Inc.
#

# We have a conf and classes directory, add to BBPATH
BBPATH =. "${LAYERDIR}:"

# We have a packages directory, add to BBFILES
BBFILES += "${LAYERDIR}/recipes-*/*/*.bb \
	${LAYERDIR}/recipes-*/*/*.bbappend"

BBFILE_COLLECTIONS += "wr-ti-j7xxx"
BBFILE_PATTERN_wr-ti-j7xxx := "^${LAYERDIR}/"
BBFILE_PRIORITY_wr-ti-j7xxx = "7"

BBMASK += "${@bb.utils.contains_any('MACHINE_FEATURES', 'gpu', '', '${LAYERDIR}/recipes-bsp/powervr-drivers/', d)}"
BBMASK += "${@bb.utils.contains_any('MACHINE_FEATURES', 'gpu', '', '${LAYERDIR}/recipes-graphics/', d)}"

# This should only be incremented on significant changes that will
# cause compatibility issues with other layers
LAYERVERSION_wr-ti-j7xxx = "1"

LAYERDEPENDS_wr-ti-j7xxx = "core wrlinux meta-ti-bsp"

LAYERSERIES_COMPAT_wr-ti-j7xxx = "wrl mickledore"

LAYERRECOMMENDS_wr-ti-j7xxx = "ti-j72xx-dl"

WRL_RECIPES:wr-ti-j7xxx += " \
    devil \
    trusted-firmware-a \
"
```

## conf/machine/ti-j7.inc
```bitbake
#@TYPE: Machine inc.
#@NAME: ti-j7

MACHINEOVERRIDES =. "ti-j7:"

DEFAULTTUNE = "cortexa72"
require conf/machine/include/arm/armv8a/tune-cortexa72.inc

MACHINE_FEATURES += "ext3 pci usbgadget usbhost vfat keyboard network"

DISTRO_FEATURES:append = " vfat serial emmc SD"

KERNEL_IMAGETYPE = "Image"
KERNEL_IMAGETYPES = "Image.gz Image"

SERIAL_CONSOLE = "115200 ttyS0"

MACHINE_EXTRA_RRECOMMENDS = " kernel-modules kernel-devicetree"
IMAGE_FSTYPES += "tar.bz2 wic wic.bmap"
WKS_FILE ?= "j7xxx-sdimage.wks"
IMAGE_INSTALL:append = " kernel-devicetree kernel-image-image"
do_image_wic[depends] += " mtools-native:do_populate_sysroot dosfstools-native:do_populate_sysroot"

KERNEL_DTBDEST = "${KERNEL_IMAGEDEST}/dtb"
KERNEL_DTBVENDORED = "1"

# multilib support
MULTILIBS ?= "multilib:lib32"
DEFAULTTUNE:virtclass-multilib-lib32 ?= "armv7athf-neon"
PREFERRED_PROVIDER_virtual/kernel ??= "linux-yocto"
PREFERRED_VERSION_linux-yocto ?= "6.1%"
MACHINE_EXTRA_RRECOMMENDS += "linux-firmware-cadence linux-firmware-pvdec-full-bin linux-firmware-cnm"

# to fix dtbo loading error due to the lack of symbols in the generated overlay dtbo file.
KERNEL_EXTRA_ARGS = " DTC_FLAGS='-@'"

PREFERRED_PROVIDER_virtual/egl = "${@bb.utils.contains("MACHINE_FEATURES", "gpu", "mesa-pvr", "mesa", d)}"
PREFERRED_PROVIDER_virtual/libgles3 = "${@bb.utils.contains("MACHINE_FEATURES", "gpu", "mesa-pvr", "mesa", d)}"
PREFERRED_PROVIDER_virtual/libgles2 = "${@bb.utils.contains("MACHINE_FEATURES", "gpu", "mesa-pvr", "mesa", d)}"
PREFERRED_PROVIDER_virtual/libgles1 = "${@bb.utils.contains("MACHINE_FEATURES", "gpu", "mesa-pvr", "mesa", d)}"
PREFERRED_PROVIDER_virtual/libgbm = "${@bb.utils.contains("MACHINE_FEATURES", "gpu", "mesa-pvr", "mesa", d)}"
PREFERRED_PROVIDER_virtual/libgl = "${@bb.utils.contains("MACHINE_FEATURES", "gpu", "mesa-pvr", "mesa", d)}"
PREFERRED_PROVIDER_virtual/libglx = "${@bb.utils.contains("MACHINE_FEATURES", "gpu", "mesa-pvr", "mesa", d)}"
PREFERRED_PROVIDER_virtual/mesa = "${@bb.utils.contains("MACHINE_FEATURES", "gpu", "mesa-pvr", "mesa", d)}"

NON_MULTILIB_RECIPES:append = " u-boot-ti-staging optee-os trusted-firmware-a ti-rtos-firmware ti-dm-fw ti-eth-fw ti-k3-secdev"
# For ostree
OSTREE_BOOTLOADER_INCLUDE ?= ""

# No u-boot
OSTREE_SD_UBOOT_WIC1 ?= ""

OSTREE_BOOTSCR_PRECMD ?= " \
setenv no_menu yes; \
setenv no_setexpr yes; \
if test ! -n \${devnum}; then setenv devnum 1; fi; \
setenv loadaddr 0x82000000; \
setenv loadaddr1 0x82000001; \
setenv loadaddr2 0x82000002; \
setenv fdt_addr 0x88000000; \
setenv initrd_addr 0x98000000; \
setenv bct_addr 0x82000200; \
setenv bct_addr1 0x82000201; \
setenv console ttyS2; \
setenv baudrate 115200; \
"

OSTREE_SD_BOOT_ALIGN ?= "4096"
OSTREE_FDISK_BLM ?= "8192"
OSTREE_FDISK_FSZ ?= "132"
INITRAMFS_IMAGE ??= ""
IMAGE_BOOT_FILES:append = " ${@bb.utils.contains('DISTRO_FEATURES', 'ostree', '${INITRAMFS_IMAGE}-${MACHINE}.${INITRAMFS_FSTYPES};initramfs boot.scr', '', d)} \
"
OSTREE_KERNEL ?= "Image"
OSTREE_COPY_IMAGE_BOOT_FILES = "1"
OSTREE_UBOOT_CMD ?= "booti"
OSTREE_WKS_EFI_SIZE ?= "--size=64M"

# For ustart.img
OSTREE_NETINST_DEV ?= "/dev/mmcblk0,/dev/sda,/dev/vda"
OSTREE_NETINST_ARGS ?= "${OSTREE_CONSOLE} bl=ufsd rdinit=/install instdev=${OSTREE_NETINST_DEV} instname=wrlinux instbr=\$BRANCH insturl=\$URL instab=${OSTREE_USE_AB} instsf=1 instdate=BUILD_DATE"
```

## conf/machine/ti-j72xx.conf
```bitbake
#@TYPE: Machine
#@NAME: ti-j72xx
#@DESCRIPTION: Machine configuration for TI J721E SoC

MACHINEOVERRIDES:prepend = "j721e:"

require conf/machine/ti-j7.inc

DTB_FILES = "k3-j721e-common-proc-board.dtb k3-j721e-evm-csi2-ov5640.dtbo k3-j721e-vision-apps.dtbo k3-j721e-edgeai-apps.dtbo \
	     k3-j721e-evm-fusion.dtbo k3-j721e-evm-quad-port-eth-exp.dtbo k3-j721e-evm-ethfw.dtbo"
KERNEL_DEVICETREE = "${@''.join('ti/%s ' % d for d in '${DTB_FILES}'.split())}"

IMAGE_BOOT_FILES ?= " Image ${DTB_FILES} u-boot.img tispl.bin sysfw.itb tiboot3.bin"
UBOOT_MACHINE = "j721e_evm_a72_config"
DEFAULT_DTB ?= "k3-j721e-common-proc-board.dtb "
OPTEEMACHINE = "k3-j721e"
TARGET_PRODUCT = "j721e_linux"
TFA_BOARD = "generic"
TFA_PLATFORM = "k3"

PREFERRED_VERSION_ti-img-rogue-umlibs = "24.1.6554834"
PREFERRED_VERSION_ti-img-rogue-driver = "24.1.6554834"
```

## conf/machine/ti-j78xx-k3r5.conf
```bitbake
# TI K3 Armv7 profile for Cortex-R5F cores

# Add extra essential overrides
MACHINEOVERRIDES:prepend = "k3r5:"

# The closest of existing tunes for Cortex-R5F
DEFAULTTUNE = "armv7athf"
require conf/machine/include/arm/armv7a/tune-cortexa8.inc

# R5 runs early bootloader and loads SYSFW
# https://git.ti.com/cgit/ti-u-boot/ti-u-boot/tree/doc/board/ti/k3.rst

PREFERRED_PROVIDER_virtual/bootloader ?= "u-boot-ti-staging"
PREFERRED_PROVIDER_u-boot ?= "u-boot-ti-staging"

SYSFW_SOC = "j784s4"
SYSFW_CONFIG = "evm"
SYSFW_SUFFIX = "gp"

UBOOT_MACHINE = "j784s4_evm_r5_defconfig"
SPL_SUFFIX = "bin"
SPL_BINARY = "tiboot3-${SYSFW_SOC}-${SYSFW_SUFFIX}-${SYSFW_CONFIG}.${SPL_SUFFIX}"
SPL_SYMLINK = "tiboot3.${SPL_SUFFIX}"
UBOOT_SUFFIX = "bin"
UBOOT_BINARY = "u-boot-r5spl.${UBOOT_SUFFIX}"
UBOOT_IMAGE = "u-boot-r5spl-${MAINMACHINE}-${PV}-${PR}.${UBOOT_SUFFIX}"
UBOOT_SYMLINK = "u-boot-r5spl-${MAINMACHINE}.${UBOOT_SUFFIX}"

PACKAGECONFIG:pn-u-boot-ti-staging = ""
```

## conf/machine/ti-j78xx.conf
```bitbake
#@TYPE: Machine
#@NAME: ti-j78xx
#@DESCRIPTION: Machine configuration for TI J784S4 SoC

require conf/machine/ti-j7.inc
DTB_FILES = "k3-j784s4-evm.dtb k3-j784s4-edgeai-apps.dtbo k3-j784s4-vision-apps.dtbo k3-j784s4-evm-virt-mac-client.dtbo \
	     k3-j721s2-evm-fusion.dtbo k3-j784s4-evm-quad-port-eth-exp1.dtbo k3-j784s4-evm-usxgmii-exp1-exp2.dtbo"
KERNEL_DEVICETREE = "${@''.join('ti/%s ' % d for d in '${DTB_FILES}'.split())}"
IMAGE_BOOT_FILES ?= " Image u-boot.img tispl.bin ${DTB_FILES}"
UBOOT_MACHINE = "j784s4_evm_a72_defconfig"
DEFAULT_DTB ?= "k3-j784s4-evm.dtb "
OPTEEMACHINE = "k3-j784s4"
TARGET_PRODUCT = "j784s4_linux"
TFA_BOARD = "j784s4"
OPTEE_K3_USART = "0x8"
TFA_K3_USART = "0x8"

PREFERRED_VERSION_trusted-firmware-a = "2.1"

PREFERRED_VERSION_ti-img-rogue-umlibs = "23.1.6404501"
PREFERRED_VERSION_ti-img-rogue-driver = "23.1.6404501"
```
